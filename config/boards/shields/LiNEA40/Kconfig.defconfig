## config/boards/shields/LiNEA40/Kconfig.defconfig
```kconfig
if SHIELD_LiNEA40_RIGHT
    config ZMK_KEYBOARD_NAME
        default "LiNEA40"
    config ZMK_SPLIT_ROLE_CENTRAL
        default y
endif

if SHIELD_LiNEA40_LEFT || SHIELD_LiNEA40_RIGHT
    config ZMK_SPLIT
        default y
endif
```

## config/boards/shields/LiNEA40/Kconfig.shield
```kconfig
config SHIELD_LiNEA40_LEFT
    def_bool $(shields_list_contains,LiNEA40_left)

config SHIELD_LiNEA40_RIGHT
    def_bool $(shields_list_contains,LiNEA40_right)
```
