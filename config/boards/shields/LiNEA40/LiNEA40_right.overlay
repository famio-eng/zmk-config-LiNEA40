#include "LiNEA40.dtsi"
#include <dt-bindings/zmk/input_transform.h>
#include <zephyr/dt-bindings/input/input-event-codes.h>

&default_transform {
    col-offset = <6>;
};

&kscan0 {
    col-gpios
        = <&xiao_d 10 GPIO_ACTIVE_HIGH>
        , <&xiao_d 9 GPIO_ACTIVE_HIGH>
        , <&xiao_d 8 GPIO_ACTIVE_HIGH>
        , <&xiao_d 7 GPIO_ACTIVE_HIGH>
        , <&gpio0 10 GPIO_ACTIVE_HIGH>
        ;
};

/* 右側ではエンコーダーを無効化してD6ピン競合を解く */
&left_encoder {
    status = "disabled";
};

&pinctrl {
    spi0_default: spi0_default {
        group1 {
            psels = <NRF_PSEL(SPIM_SCK, 0, 5)>,
                    <NRF_PSEL(SPIM_MOSI, 0, 4)>,
                    <NRF_PSEL(SPIM_MISO, 0, 4)>;
        };
    };
    spi0_sleep: spi0_sleep {
        group1 {
            psels = <NRF_PSEL(SPIM_SCK, 0, 5)>,
                    <NRF_PSEL(SPIM_MOSI, 0, 4)>,
                    <NRF_PSEL(SPIM_MISO, 0, 4)>;
            low-power-enable;
        };
    };
};

&spi0 {
    status = "okay";
    compatible = "nordic,nrf-spim";
    pinctrl-0 = <&spi0_default>;
    pinctrl-1 = <&spi0_sleep>;
    pinctrl-names = "default", "sleep";
    cs-gpios = <&gpio0 9 GPIO_ACTIVE_LOW>;

    /* 修正箇所: ラベル参照 &trackball ではなくノード名で記述 */
    trackball: trackball@0 {
        status = "okay";
        compatible = "pixart,pmw3610";
        reg = <0>;
        spi-max-frequency = <2000000>;
        irq-gpios = <&xiao_d 6 (GPIO_ACTIVE_LOW | GPIO_PULL_UP)>;
    };
};

/ {
    /* 1) DYA Studio用：マウス移動（レイヤー2で有効にする例） */
    trackball_runtime_proc: trackball_runtime_proc {
        compatible = "zmk,input-processor-runtime";
        #input-processor-cells = <0>;
        processor-label = "Mouse";       /* 8文字以内 */
        type = <0x02>;                   /* INPUT_EV_REL */
        x-codes = <0x00>;                /* REL_X */
        y-codes = <0x01>;                /* REL_Y */

        /* 初期感度（DYAで後から変更可能） */
        scale-multiplier = <1>;
        scale-divisor = <1>;
        rotation-degrees = <0>;
        track-remainders;

        /* MOUSEレイヤー(2)の時だけ有効にしたい場合：bit2 = 1<<2 = 4 */
        active-layers = <4>;
    };


    /* 2) DYA Studio用：スクロール（レイヤー6で有効にする例） */
    trackball_scroll_proc: trackball_scroll_proc {
        compatible = "zmk,input-processor-runtime";
        #input-processor-cells = <0>;
        processor-label = "Scroll";      /* 8文字以内 */
        type = <0x02>;                   /* INPUT_EV_REL */
        x-codes = <0x00>;                /* REL_X */
        y-codes = <0x01>;                /* REL_Y */

        /* XY→スクロール変換を runtime 側で有効化 */
        xy-to-scroll-enabled;

        /* 初期スクロール感度（DYAで後から変更可能）
           - Macで大きすぎるなら divisor を大きく（例 3）
           - Winで小さいなら multiplier を上げる（例 2） */
        scale-multiplier = <1>;
        scale-divisor = <3>;
        rotation-degrees = <0>;
        track-remainders;

        /* SCROLLレイヤー(6)だけで有効：bit6 = 1<<6 = 64 */   
        active-layers = <64>;
    };



    /* 右側専用のトラックボール・リスナー（統合版） */
    trackball_listener: trackball_listener {
        compatible = "zmk,input-listener";
        device = <&trackball>;
        status = "okay";
        /* * DYA用のプロセッサと、オートマウスを両方有効化　*/
        input-processors =
            <&trackball_runtime_proc>,        /* DYA: Mouse */
            <&trackball_scroll_proc>,         /* DYA: Scroll */

    };
};
