/*
 * USB/CDC ACM機能を有効化し、ノードを参照可能にする
 */

&usbd {
    status = "okay";
};

// 🚨 CDC ACM ノードに &uart1 を使用（XIAO BLEでの一般的な定義）
&uart1 {
    compatible = "nordic,nrf-uarte";
    current-speed = <115200>;
    status = "okay";
};
