## config/west.yml
```yaml
manifest:
  remotes:
    - name: zmkfirmware
      url-base: https://github.com/zmkfirmware
    - name: inorichi
      url-base: https://github.com/inorichi
    - name: keyfreaks
      url-base: https://github.com/kay-yokoyama
    - name: caksoylar
      url-base: https://github.com/caksoylar
    - name: oleksandrmaslov
      url-base: https://github.com/oleksandrmaslov
    - name: famio-eng
      url-base: https://github.com/famio-eng
  projects:
    - name: zmk
      remote: zmkfirmware
      revision: v0.2.1
      import: app/west.yml
    - name: zmk-pmw3610-driver
      remote: inorichi
      revision: main
    - name: zmk-rgbled-widget
      remote: caksoylar
      revision: v0.3-branch
    - name: zmk-pointing-acceleration
      remote: famio-eng
      revision: main
      #famio-eng/zmk-pointing-acceleration(oleksandrmaslov/zmk-pointing-accelerationのフォーク)を参照。
      #減速カーブ(min-factor>max-factor)を設定可能にするクランプ修正のため。
      #フォーク内にデバッグ用LOG_INFも残っているが、CONFIG_INPUT_LOG_LEVEL_INFとzmk-usb-loggingを
      #外したことでコンパイル時に無効化される(2026-08-14、フリーズ調査で判明・対処)
  self:
    path: config
```
