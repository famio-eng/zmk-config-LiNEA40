/*
 * Localized Keys for ja
 *
 * This file was generated from data with the following license:
 *
 * Copyright (c) 2025 The ZMK Contributors
 * 
 * SPDX-License-Identifier: MIT
 */

#pragma once

#include <dt-bindings/zmk/hid_usage.h>
#include <dt-bindings/zmk/hid_usage_pages.h>
#include <dt-bindings/zmk/modifiers.h>
