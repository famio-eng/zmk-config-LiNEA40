#include <dt-bindings/zmk/keys.h>

#define JP_EQUAL           EQUAL
#define JP_MINUS           MINUS
#define JP_YEN             NON_US_HASH
#define JP_HAT             GRAVE
#define JP_AT              LBRACKET
#define JP_LBRACKET        RBRACKET
#define JP_SEMICOLON       SEMICOLON
#define JP_COLON           SQUOTE
#define JP_RBRACKET        BACKSLASH
#define JP_COMMA           COMMA
#define JP_DOT             DOT
#define JP_SLASH           SLASH
#define JP_BS_SLASH        NON_US_BSLH
#define JP_NONUS_BSLH      NON_US_BSLH
#define JP_NONUS_HASH      NON_US_HASH
